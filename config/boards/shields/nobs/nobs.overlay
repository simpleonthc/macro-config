/ {
    chosen {
        zmk,kscan = &default_kscan;
    };

    default_kscan: kscan {
        compatible = "zmk,kscan-gpio-direct";
        label = "default_kscan";

        input-gpios =
            <&pro_micro 7 (GPIO_ACTIVE_HIGH | GPIO_PULL_UP)>,
            <&pro_micro 8 (GPIO_ACTIVE_HIGH | GPIO_PULL_UP)>,
            <&pro_micro 9 (GPIO_ACTIVE_HIGH | GPIO_PULL_UP)>,
    };
};